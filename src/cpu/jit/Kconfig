## src/cpu/jit/Kconfig
```kconfig
config USE_JITCPU
    depends on USE_RISCV_ISA
    bool "Enable the RISC-V QEMU/TCG JitCPU model"
    default n
    help
      Build the RISC-V-only JitCPU loader. The GPL-covered QEMU backend is
      built separately from the pinned ext/qemu/repo submodule and the
      adapter sources in ext/qemu/gem5-jit.
```
